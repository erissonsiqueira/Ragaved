/**
  ************************************************************************************************************************
  * @file    	eas_lcd.c
  * @author  	Erisson Siqueira
	* @version	v1.0
  ************************************************************************************************************************
 */
 
/* Includes ------------------------------------------------------------------------------------------------------------*/
#include "stm32f4xx.h"
#include "eas_lcd.h"

/* Variables -----------------------------------------------------------------------------------------------------------*/

/* Functions -----------------------------------------------------------------------------------------------------------*/
/*************************************************************************************************************************
 * @name vLCD_WriteNibble
 ************************************************************************************************************************/
void vLCD_WriteNibble(uint8_t nb){
  
  LCD_D4( nb&0x01);
  LCD_D5((nb&0x02)>>1);
  LCD_D6((nb&0x04)>>2);
  LCD_D7((nb&0x08)>>3);  
  LCD_RW(0);
  LCD_E(1);
	for(uint16_t i=0; i<500; i++){}
  LCD_E(0);
	for(uint16_t i=0; i<500; i++){}
}

/*************************************************************************************************************************
 * @name vLCD_WriteCmd
 ************************************************************************************************************************/
void vLCD_WriteCmd(uint8_t cmd){
  
  LCD_RS(0);
  vLCD_WriteNibble(cmd>>4);
  vLCD_WriteNibble(cmd);
}

/*************************************************************************************************************************
 * @name vLCD_WriteData
 ************************************************************************************************************************/
void vLCD_WriteData(uint8_t data){
  
  LCD_RS(1);
  vLCD_WriteNibble(data>>4);
  vLCD_WriteNibble(data);
}

/*************************************************************************************************************************
 * @name vLCD_SetCursor
 ************************************************************************************************************************/
void vLCD_SetCursor(uint8_t col, uint8_t line){
  
  uint8_t addr;
  switch (line){
    case 0:
    case 1:
      addr = (line * 0x40) + (char)col;
      addr = 0x80 + (addr & 0x7F);
      break;
    default: break;
  }
  vLCD_WriteCmd(addr);
}

/*************************************************************************************************************************
 * @name vLCD_Clear
 ************************************************************************************************************************/
void vLCD_Clear(void){
  
  vLCD_WriteCmd(0x01);
  vLCD_SetCursor(0,0);
}

/*************************************************************************************************************************
 * @name vLCD_PutChar
 ************************************************************************************************************************/
void vLCD_PutChar(char c){
  
  vLCD_WriteData (c);
}

/*************************************************************************************************************************
 * @name vLCD_Print
 ************************************************************************************************************************/
void vLCD_Print(char *str){
  
  while(*str)
    vLCD_PutChar(*str++);
}

/*************************************************************************************************************************
 * @name vLCD_Init
 ************************************************************************************************************************/
void vLCD_Init(void){
  
  HAL_Delay(15);
  LCD_RS(0);
  vLCD_WriteNibble(0x3);
	HAL_Delay(5);
  vLCD_WriteNibble(0x3);
	HAL_Delay(5);
  vLCD_WriteNibble(0x3);
  vLCD_WriteNibble(0x2);
  vLCD_WriteCmd(0x28);
  vLCD_WriteCmd(0x0C);
  vLCD_WriteCmd(0x06);
  vLCD_Clear();
	HAL_Delay(100);
}

/*************************************************************************************************************************
 * @name vLCD_Screen
 ************************************************************************************************************************/
void vLCD_Screen(uint8_t screen){
  
  char line0[16]={0};
  char line1[16]={0};
	
  switch (screen){
		
	 	case 0:
      sprintf(&line0[0], "     Screen     ");
      sprintf(&line1[0], "       00       ");
    break;
    
  	case 1:
      sprintf(&line0[0], "     Screen     ");
      sprintf(&line1[0], "       01       ");
    break;
    
    case 2:
      sprintf(&line0[0], "     Screen     ");
      sprintf(&line1[0], "       02       ");
    break;
		
		case 3:
      sprintf(&line0[0], "     Screen     ");
      sprintf(&line1[0], "       03       ");
    break;
    
    default:break;
  }
  
  vLCD_SetCursor(0,0);
  vLCD_Print(line0);
  vLCD_SetCursor(0,1);
  vLCD_Print(line1);
}
